## conf/layer.conf
```bitbake
# We have a conf and classes directory, add to BBPATH
BBPATH .= ":${LAYERDIR}"

# We have a packages directory, add to BBFILES
BBFILES += "${LAYERDIR}/recipes-*/*/*.bb \
            ${LAYERDIR}/recipes-*/*/*.bbappend"

BBFILE_COLLECTIONS      += "qcom-hwe"
BBFILE_PATTERN_qcom-hwe   = "^${LAYERDIR}/"
BBFILE_PRIORITY_qcom-hwe  = "6"

LAYERDEPENDS_qcom-hwe = "qcom"
LAYERSERIES_COMPAT_qcom-hwe = "scarthgap"

LICENSE_PATH += "${LAYERDIR}/files/common-licenses"

BBFILES_DYNAMIC += " \
    chromium-browser-layer:${LAYERDIR}/dynamic-layers/chromium-browser-layer/*/*/*.bb \
    chromium-browser-layer:${LAYERDIR}/dynamic-layers/chromium-browser-layer/*/*/*.bbappend \
    core:${LAYERDIR}/dynamic-layers/core/*/*/*.bb \
    core:${LAYERDIR}/dynamic-layers/core/*/*/*.bbappend \
    meta-tensorflow:${LAYERDIR}/dynamic-layers/meta-tensorflow/*/*/*.bbappend \
    networking-layer:${LAYERDIR}/dynamic-layers/networking-layer/*/*/*.bb \
    networking-layer:${LAYERDIR}/dynamic-layers/networking-layer/*/*/*.bbappend \
    openembedded-layer:${LAYERDIR}/dynamic-layers/openembedded-layer/*/*/*.bb \
    openembedded-layer:${LAYERDIR}/dynamic-layers/openembedded-layer/*/*/*.bbappend \
    selinux:${LAYERDIR}/dynamic-layers/selinux/*/*/*.bb \
    selinux:${LAYERDIR}/dynamic-layers/selinux/*/*/*.bbappend \
    sota:${LAYERDIR}/dynamic-layers/sota/*/*/*.bb \
    sota:${LAYERDIR}/dynamic-layers/sota/*/*/*.bbappend \
    virtualization-layer:${LAYERDIR}/dynamic-layers/virtualization-layer/*/*/*.bb \
    virtualization-layer:${LAYERDIR}/dynamic-layers/virtualization-layer/*/*/*.bbappend \
"

QCOM_COMMON_LICENSE_DIR = "${@os.path.normpath("${LAYERDIR}")+'/files/common-licenses/'}"

# Set a variable to get to the top of this metalayer
QCOMHWEBASE = '${@os.path.normpath("${LAYERDIR}")}'
```

## conf/machine/include/qcom-prebuilts.inc
```bitbake
PBT_ARTIFACTORY ?= "https://softwarecenter.qualcomm.com/nexus/generic/product/chip/software-product-family/Qualcomm_Linux.SPF.1.0/qualcomm_linux.spf.1.0-test-device-public"
PBT_BUILD_ID    ?= "r1.0_00123.0"
PBT_BIN_PATH    ?= "LE.QCLINUX.1.0.R1/apps_proc/prebuilt_HY22/${BPN}/260530"
```

## conf/machine/include/qcom-qcs9100.inc
```bitbake
DEFAULTTUNE = "armv8-2a-crypto"
require conf/machine/include/arm/arch-armv8-2a.inc

SOC_FAMILY = "qcs9100"
require conf/machine/include/qcom-base.inc

# Additional Kernel cmdline parameters for debug builds
DBG_CMDLINE = "${@oe.utils.conditional('DEBUG_BUILD','1','earlycon reboot=panic_warm page_owner=on qcom_scm.download_mode=1 slub_debug=FZP,zs_handle,zspage;FZPU','',d)}"

KERNEL_CMDLINE_EXTRA ?= "pcie_pme=nomsi net.ifnames=0 pci=noaer kpti=off kasan=off kasan.stacktrace=off swiotlb=128 ${DBG_CMDLINE} mitigations=auto rcupdate.rcu_expedited=1 rcu_nocbs=0-7 no-steal-acc vfio_iommu_type1.allow_unsafe_interrupts=1 fw_devlink.strict=1 vfio_platform.reset_required=0 amc6821.pwminv=1"

MACHINE_ESSENTIAL_EXTRA_RRECOMMENDS += " \
    fastrpc \
    kernel-modules \
    pd-mapper \
    modemmanager \
    networkmanager-nmcli \
    networkmanager-wifi \
    qrtr \
"

MACHINE_EXTRA_RDEPENDS += " \
    packagegroup-firmware-qcs9100 \
"

MACHINE_EXTRA_RRECOMMENDS:append:qcom-custom-bsp = " \
    qcom-subsystem-ramdump \
    trace-cmd \
    remote-debug-agent \
    securedsp-example \
"
```
