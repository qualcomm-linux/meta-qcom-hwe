## conf/machine/qcs8275-iq-8275-evk-ifp.conf
```bitbake
#@TYPE: Machine
#@NAME: qcs8275-iq-8275-evk-ifp
#@DESCRIPTION: Machine configuration for Qualcomm IQ-8275 Evaluation Kit(EVK), with qcs8275

require conf/machine/include/qcom-qcs8300.inc

MACHINE_FEATURES = "usbhost usbgadget alsa wifi"

# This DT is available in Linux stable tree, 6.6.y branch.
KERNEL_DEVICETREE:pn-linux-qcom-base = " \
                      qcom/qcs8275-iq-8275-evk.dtb \
                      "

KERNEL_DEVICETREE:pn-linux-qcom-custom = " \
                      qcom/qcs8275-addons-iq-8275-evk-mezz.dtb \
                      "

# Additional dtbo to overlay on top of kernel devicetree files
KERNEL_TECH_DTBOS[qcs8275-addons-iq-8275-evk-mezz] = " \
    qcs8300-video.dtbo qcs8300-graphics.dtbo \
    "

# Recipe providers of above dtbo files.
KERNEL_TECH_DTBO_PROVIDERS = "\
    qcom-videodtb \
    qcom-graphicsdevicetree \
"
```

## conf/machine/qcs9075-iq-9075-evk.conf
```bitbake
#@TYPE: Machine
#@NAME: qcs9075-iq-9075-evk
#@DESCRIPTION: Machine configuration for Qualcomm IQ-9075 Evaluation Kit(EVK), with qcs9075

require conf/machine/include/qcom-qcs9100.inc

MACHINE_FEATURES = "usbhost usbgadget alsa wifi bluetooth"

# This DT is available in Linux stable tree, 6.6.y branch.
KERNEL_DEVICETREE:pn-linux-qcom-base = " \
                      qcom/qcs9075-iq-9075-evk.dtb \
                      "

KERNEL_DEVICETREE:pn-linux-qcom-custom = " \
                      qcom/qcs9075-addons-iq-9075-evk.dtb \
                      "

# Additional dtbo to overlay on top of kernel devicetree files
KERNEL_TECH_DTBOS[qcs9075-addons-iq-9075-evk] = " \
    sa8775p-video.dtbo qcs9100-graphics.dtbo \
    qcs9075-camera-iq-9075-evk.dtbo \
    "

# Recipe providers of above dtbo files.
KERNEL_TECH_DTBO_PROVIDERS = "\
    qcom-graphicsdevicetree \
    qcom-videodtb \
    cameradtb \
"

MACHINE_EXTRA_RDEPENDS += " \
    packagegroup-tpm \
"
```
